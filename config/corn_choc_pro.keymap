/*
 * Copyright (c) 2020 The ZMK Contributors
 *
 * SPDX-License-Identifier: MIT
 */

#include <dt-bindings/zmk/mouse.h>
#include <behaviors.dtsi>
#include <dt-bindings/zmk/bt.h>
#include <dt-bindings/zmk/keys.h>
#include <dt-bindings/zmk/pointing.h>
#include <dt-bindings/zmk/rgb.h>

/ {
    chosen { zmk,physical-layout = &default_layout; };
};

/ {
    behaviors {
        hml: homerow_mods_left {
            compatible = "zmk,behavior-hold-tap";
            #binding-cells = <2>;
            flavor = "balanced";
            tapping-term-ms = <280>;
            quick-tap-ms = <175>;
            require-prior-idle-ms = <150>;
            bindings = <&kp>, <&kp>;
            hold-trigger-key-positions = <
                7  8  9  10 11 12 13
                21 22 23 24 25 26 27
                34 35 36 37 38 39
                   37 38 39
            >;
            hold-trigger-on-release;
        };

        hmr: homerow_mods_right {
            compatible = "zmk,behavior-hold-tap";
            #binding-cells = <2>;
            flavor = "balanced";
            tapping-term-ms = <280>;
            quick-tap-ms = <175>;
            require-prior-idle-ms = <150>;
            bindings = <&kp>, <&kp>;
            hold-trigger-key-positions = <
                0  1  2  3  4  5  6
                14 15 16 17 18 19 20
                28 29 30 31 32 33
                   34 35 36
            >;
            hold-trigger-on-release;
        };
    };

    keymap {
        compatible = "zmk,keymap";

        default_layer {
            display-name = "QWERTY";

            // --------------------------------------------------------------------------------
            // |  TAB |  Q  |  W  |  E  |  R  |  T  |  MUTE |  PP   |  Y  |  U   |  I  |  O  |  P  | BSPC |
            // | CTRL |  A  |  S  |  D  |  F  |  G  |  LALT |  RALT |  H  |  J   |  K  |  L  |  ;  |  '   |
            // | SHFT |  Z  |  X  |  C  |  V  |  B  |               |  N  |  M   |  ,  |  .  |  /  | ESC  |
            //                    | GUI | LWR | SPC |               | ENT | RSE  | ALT |

            bindings = <
&kp TAB     &kp Q         &kp W         &kp E          &kp R          &kp T      &kp LCTRL  &kp RCTRL  &kp Y      &kp U          &kp I          &kp O         &kp P             &kp BSPC
&kp ESCAPE  &hml LGUI A   &hml LALT S   &hml LCTRL D   &hml LSHFT F   &kp G      &kp LALT   &kp RALT   &kp H      &hmr RSHFT J   &hmr RCTRL K   &hmr RALT L   &hmr RGUI SEMI    &kp SQT
&kp LSHFT   &kp Z         &kp X         &kp C          &kp V          &kp B                            &kp N      &kp M          &kp COMMA      &kp DOT       &kp FSLH          &kp RSHIFT
                          &kp LGUI      &lt 1 RET      &kp ENTER                        &kp SPACE  &lt 2 SPACE  &kp DELETE
            >;

            sensor-bindings = <&inc_dec_kp C_VOL_DN C_VOL_UP &inc_dec_kp PG_UP PG_DN &inc_dec_kp C_PREV C_NEXT &inc_dec_kp C_VOL_DN C_VOL_UP>;
        };

        lower_layer {
            display-name = "NUMBER";

            // -----------------------------------------------------------------------------------------
            // |  TAB |  1  |  2  |  3  |  4  |  5    |  LCTRL | RCTRL |  6  |  7  |  8  |  9  |  0  | BSPC |
            // | CTRL | BT1 | BT2 | BT3 | BT4 | BT5   |  LALT  | RALT  | LFT | DWN |  UP | RGT |     |      |
            // | SHFT | BTCR| RGB | RST | BOOT| Unlock|        |       |     |     |     |     |     |      |
            //                    | GUI |     | SPC   |        | ENT   |     | ALT |

            bindings = <
&kp TAB     &kp N1        &kp N2           &kp N3        &kp N4        &kp N5          &kp LCTRL  &kp RCTRL  &kp N6          &kp N7          &kp N8        &kp N9           &kp N0  &kp BSPC
&kp ESCAPE  &bt BT_SEL 0  &bt BT_SEL 1     &bt BT_SEL 2  &bt BT_SEL 3  &bt BT_SEL 4    &kp LALT   &kp RALT   &kp LEFT        &kp DOWN        &kp UP        &kp RIGHT        &kp LS(LC(LG(N4)))  &kp LS(LC(LG(N5)))
&kp LSHFT   &bt BT_CLR    &rgb_ug RGB_TOG  &sys_reset    &bootloader   &studio_unlock                        &mmv MOVE_LEFT  &mmv MOVE_DOWN  &mmv MOVE_UP  &mmv MOVE_RIGHT  &trans  &trans
                                           &kp LGUI      &mo 1         &kp ENTER                             &kp SPACE       &mo 2           &kp DELETE
            >;
        };

        raise_layer {
            display-name = "SYMBOL";

            // -----------------------------------------------------------------------------------------
            // |  TAB |  !  |  @  |  #  |  $  |  %  | LCTRL | RCTRL |  ^  |  &  |  *  |  (  |  )  | BSPC |
            // | CTRL | HUD | HUI |     |     |     |  LALT | RALT  |  -  |  =  |  [  |  ]  |  \  |  `   |
            // | SHFT |     |     |     |     |     |               |  _  |  +  |  {  |  }  | "|" |  ~   |
            //                    | GUI |     | SPC |               | ENT |     | ALT |

            bindings = <
&kp TAB    &kp EXCL         &kp AT           &kp HASH         &kp DLLR         &kp PRCNT        &kp LCTRL  &kp RCTRL  &kp CARET  &kp AMPS   &kp ASTRK   &kp LPAR  &kp RPAR  &kp BSPC
&kp LCTRL  &rgb_ug RGB_HUI  &rgb_ug RGB_SAI  &rgb_ug RGB_SPI  &rgb_ug RGB_EFF  &rgb_ug RGB_BRI  &kp LALT   &kp RALT   &kp MINUS  &kp EQUAL  &kp LBKT    &kp RBKT  &kp BSLH  &kp GRAVE
&kp LSHFT  &rgb_ug RGB_HUD  &rgb_ug RGB_SAD  &rgb_ug RGB_SPD  &rgb_ug RGB_EFR  &rgb_ug RGB_BRD                        &kp UNDER  &kp PLUS   &kp LBRC    &kp RBRC  &kp PIPE  &kp TILDE
                                             &kp LGUI         &mo 1            &kp ENTER                              &kp SPACE  &mo 2      &kp DELETE
            >;
        };

        extra_layer_1 {
            display-name = "EXTRA 1";
            bindings = <
&trans  &trans  &trans  &trans  &trans  &trans  &trans  &trans  &trans  &trans  &trans  &trans  &trans  &trans
&trans  &trans  &trans  &trans  &trans  &trans  &trans  &trans  &trans  &trans  &trans  &trans  &trans  &trans
&trans  &trans  &trans  &trans  &trans  &trans                  &trans  &trans  &trans  &trans  &trans  &trans
                        &trans  &trans  &trans                  &trans  &trans  &trans
            >;
        };

        extra_layer_2 {
            display-name = "EXTRA 2";
            bindings = <
&trans  &trans  &trans  &trans  &trans  &trans  &trans  &trans  &trans  &trans  &trans  &trans  &trans  &trans
&trans  &trans  &trans  &trans  &trans  &trans  &trans  &trans  &trans  &trans  &trans
